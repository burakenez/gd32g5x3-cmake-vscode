# GD32G5x3 register map
File version: 1.0
GD32G5x3 ARM 32-bit Cortex-M33 Microcontroller based device
CPU: CM33 r2p1, little endian, MPU, FPU, 4 interrupt priority bits
Registers are 32-bit, read-write, reset 0x0 unless marked. A register's access mark holds for its fields unless they carry their own. Offsets are from the block's base; lines under a group give offsets from that group; [hi:lo] are bit positions; {n}, {i} and the like mark numbered series; 'fields as' and 'values as' point back to an identical list; <NAME> marks a mode.

## Memory map
0x40000000 TIMER1 size 0x400 — General level0 timer
0x40000400 TIMER2 size 0x400 — General level0 timer
0x40000800 TIMER3 size 0x400
0x40000C00 TIMER4 size 0x400
0x40001000 TIMER5 size 0x400 — Basic timer
0x40001400 TIMER6 size 0x400
0x40002800 RTC size 0x400 — Real-time clock
0x40002C00 WWDGT size 0x400 — Window watchdog timer
0x40003000 FWDGT size 0x400 — free watchdog timer
0x40003800 SPI1 size 0x400 — Serial peripheral interface
0x40003C00 SPI2 size 0x400 — Serial peripheral interface
0x40004400 USART1 size 0x400
0x40004800 USART2 size 0x400
0x40004C00 UART3 size 0x400 — Universal asynchronous receiver / transmitter
0x40005000 UART4 size 0x400
0x40005400 I2C0 size 0x400 — Inter integrated circuit
0x40005800 I2C1 size 0x400
0x40005C00 I2C3 size 0x400
0x40007000 PMU size 0x400 — Power management unit
0x40009400 LPTIMER size 0x400 — Low power timer
0x4000C000 I2C2 size 0x400
0x40010000 SYSCFG size 0x400 — System and memory architectur
0x40010400 EXTI size 0x400 — External interrupt/event controller
0x40012C00 TIMER0 size 0x400 — Advanced-timers
0x40013000 SPI0 size 0x400 — Serial peripheral interface
0x40013400 TIMER7 size 0x400
0x40013800 USART0 size 0x400 — Universal synchronous/asynchronous receiver / transmitter
0x40014000 TIMER14 size 0x400 — General level3 timer
0x40014400 TIMER15 size 0x400 — General level4 timer
0x40014800 TIMER16 size 0x400
0x40015000 TIMER19 size 0x400
0x40015800 HRTIMER_MASTER_TIMER size 0x80 — Super High-Resolution Timer
0x40015880 HRTIMER_SLAVE_TIMER0 size 0x80
0x40015900 HRTIMER_SLAVE_TIMER1 size 0x80
0x40015980 HRTIMER_SLAVE_TIMER2 size 0x80
0x40015A00 HRTIMER_SLAVE_TIMER3 size 0x80
0x40015A80 HRTIMER_SLAVE_TIMER4 size 0x80
0x40015B00 HRTIMER_SLAVE_TIMER5 size 0x80
0x40015B80 HRTIMER_COMMON size 0x400
0x40016000 HRTIMER_SLAVE_TIMER6 size 0x80
0x40016080 HRTIMER_SLAVE_TIMER7 size 0x80
0x40017000 HPDF size 0x400 — High Performance Digital Filter
0x40017800 VREF size 0x400
0x40017C00 CMP size 0x400 — Comparator
0x40018400 TRIGSEL size 0x400 — Trigger selection controller
0x4001A000 CAN0 size 0x1000 — Controller area network
0x4001B000 CAN1 size 0x1000
0x4001C000 CAN2 size 0x1000
0x40020000 DMA0 size 0x400 — DMA0 controller
0x40020400 DMA1 size 0x400 — DMA1 controller
0x40020800 DMAMUX size 0x400 — DMA request multiplexer
0x40021000 RCU size 0x400 — Reset and clock unit
0x40022000 FMC size 0x400 — Flash memory controller
0x40023000 CRC size 0x400 — Cyclic redundancy checks management unit
0x40025000 FFT size 0x2800 — Fast Fourier Transform
0x40038000 CLA size 0x400 — Configurable Logic Array
0x48000000 GPIOA size 0x400 — General-purpose I/Os
0x48000400 GPIOB size 0x400 — General-purpose I/Os
0x48000800 GPIOC size 0x400 — General-purpose I/Os
0x48000C00 GPIOD size 0x400
0x48001000 GPIOE size 0x400
0x48001400 GPIOF size 0x400
0x48001800 GPIOG size 0x400
0x48021000 CAU size 0x400 — Cryptographic Acceleration Unit
0x48021800 TRNG size 0x400 — True random number generator
0x48022800 CPDM size 0x400 — Clock phase delay module
0x48024400 TMU size 0x400 — Trigonometric Math Unit
0x48024800 FAC size 0x400 — Filter arithmetic accelerator
0x50000000 ADC0 size 0x400 — Analog-to-digital converter
0x50000400 ADC1 size 0x400 — Analog-to-digital converter
0x50000800 ADC2 size 0x400 — Analog-to-digital converter
0x50000C00 ADC3 size 0x400 — Analog-to-digital converter
0x50001000 DAC0 size 0x400 — Digital-to-analog converter
0x50001400 DAC1 size 0x400
0x50001800 DAC2 size 0x400
0x50001C00 DAC3 size 0x400
0xA0000000 EXMC size 0x400 — External memory controller
0xA0001000 QSPI size 0x400 — Quad-SPI interface
0xE000E100 NVIC size 0xF00 — Nested Vectored Interrupt Controller
0xE0044000 DBG size 0x400 — Debug

## Interrupts
0 WWDGT — WWDGT interrupt
1 LVD_AVD_OVD (PMU) — LVD/AVD/OVD through EXTI Line 16 interrupt
2 RTC_Tamper_Timestamp_LXTAL_STUCK (RTC) — RTC Tamper and TimeStamp from EXTI Line 18 Interrupt and LXTAL clock stuck interrupt
3 RTC_WAKE (RTC) — RTC Wakeup from EXTI Line 19 interrupt
4 FMC_GLOBAL (FMC) — FMC global interrupt
5 RCU_GLOBAL (RCU) — RCU global interrupt
6 EXTI_Line0 (EXTI) — EXTI Line0 interrupt
7 EXTI_Line1 (EXTI) — EXTI Line1 interrupt
8 EXTI_Line2 (EXTI) — EXTI Line2 interrupt
9 EXTI_Line3 (EXTI) — EXTI Line3 interrupt
10 EXTI_Line4 (EXTI) — EXTI Line4 interrupt
11 DMA0_Channel0 (DMA0) — DMA0 Channel0 global interrupt
12 DMA0_Channel1 (DMA0) — DMA0 Channel1 global interrupt
13 DMA0_Channel2 (DMA0) — DMA0 Channel2 global interrupt
14 DMA0_Channel3 (DMA0) — DMA0 Channel3 global interrupt
15 DMA0_Channel4 (DMA0) — DMA0 Channel4 global interrupt
16 DMA0_Channel5 (DMA0) — DMA0 Channel5 global interrupt
17 DMA0_Channel6 (DMA0) — DMA0 Channel6 global interrupt
18 ADC0_1 (ADC0) — ADC0 and ADC1 global interrupt
23 EXTI_line9_5 (EXTI) — EXTI Line5_9 interrupt
24 TIMER0_BRK (TIMER0) — TIMER0 break interrupt
25 TIMER0_UP (TIMER0) — TIMER0 update interrupt
26 TIMER0_TR_CM_DEC_ZERO (TIMER0) — TIMER0 trigger and commutation interrupt/ TIMER0 Direction Change interrupt/TIMER0 zero
27 TIMER0_CAP (TIMER0) — TIMER0 capture compare interrupt
28 TIMER1 — TIMER1 global interrupt
29 TIMER2 — TIMER2 global interrupt
30 TIMER3 — TIMER3 global interrupt
31 I2C0_EV_WAKE (I2C0) — I2C0 event interrupt and wakeup through EXTI line 31 interrupt
32 I2C0_ER (I2C0) — I2C0 error interrupt
33 I2C1_EV_WAKE (I2C1) — I2C1 event interrupt and wakeup through EXTI line 32 interrupt
34 I2C1_ER (I2C1) — I2C1 error interrupt
35 SPI0 — SPI0 global interrupt
36 SPI1 — SPI1 global interrupt
37 USART0 — USART0 global interrupt and wakeup through EXTI line 28 interrupt
38 USART1 — USART1 global interrupt and wakeup through EXTI line 29 interrupt
39 USART2 — USART2 global interrupt and wakeup through EXTI line 30 interrupt
40 EXTI_line15_10 (EXTI) — EXTI Line10_15 interrupt
41 RTC_Alarm (RTC) — RTC alarm from EXTI line 17 interrupt
43 TIMER7_BRK_TE_ZE (TIMER7) — TIMER19 Break interrupt/ TIMER19 Transition error/TIMER19 zero error
44 TIMER7_UP (TIMER7) — TIMER19 Update interrupt
45 TIMER7_TR_CM_DEC_ZERO (TIMER7) — TIMER7 Trigger and commutation interrupt/TIMER19 Direction Change interrupt/TIMER19 zero
46 TIMER7_CAP (TIMER7) — TIMER7 capture compare interrupt
47 ADC2 — ADC2 global interrupt
48 SYSCFG — SYSCFG interrupt
49 LPTIMER — LPTIMER global interrupt
50 TIMER4 — TIMER4 global interrupt
51 SPI2 — SPI2 global interrupt
52 UART3 — UART3 global interrupt
53 UART4 — UART4 global interrupt
54 TIMER5_DAC_0_2 (TIMER5) — TIMER5 global interrupt and DAC0/DAC2 underrun error interrupt
55 TIMER6_DAC_1_3 (TIMER6) — TIMER6 global interrupt and DAC1/DAC3 underrun error interrupt
56 DMA1_Channel0 (DMA1) — DMA1 Channel0 global interrupt
57 DMA1_Channel1 (DMA1) — DMA1 Channel1 global interrupt
58 DMA1_Channel2 (DMA1) — DMA1 Channel2 global interrupt
59 DMA1_Channel3 (DMA1) — DMA1 Channel3 global interrupt
60 DMA1_Channel4 (DMA1) — DMA1 Channel4 global interrupt
61 ADC3 — ADC3 global interrupt
63 UVD2_OVD2 (PMU)
64 CMP0_1_2_3 (CMP) — CMP0/CMP1/CMP2/CMP3 through EXTI lines 20/21/22/23 interrupts
65 CMP4_5_6_7 (CMP) — CMP4/CMP5/CMP6/CMP7 through EXTI lines 24/36/37/38 interrupts
66 CMP_GLOBAL (CMP) — CMP global interrupt
{n+67} HRTIMER_IRQ{n} (HRTIMER_MASTER_TIMER) (n=0..9) — HRTIMER_IRQ{n} interrupt
77 TIMER19_BRK_TE_ZE (TIMER19) — TIMER19 Break interrupt/ TIMER19 Transition error/TIMER19 zero error
78 TIMER19_UP (TIMER19) — TIMER19 Update interrupt
79 TIMER19_TR_CM_DEC_ZERO (TIMER19) — TIMER19 Trigger and commutation interrupt/TIMER19 Direction Change interrupt/TIMER19 zero
80 TIMER19_CAP (TIMER19) — TIMER19 capture compare interrupt
81 FPU (SYSCFG) — FPU global interrupt
82 I2C2_EV_WAKE (I2C2) — I2C2 event interrupt and I2C2 Wakeup through EXTI line 33 interrupt
83 I2C2_ER (I2C2) — I2C2 error interrupt
85 CAU — CAU global interrupt
90 TRNG — TRNG global interrupt
92 I2C3_EV_WAKE (I2C3) — I2C3 event interrupt and I2C3 Wakeup through EXTI line 34 interrupt
93 I2C3_ER (I2C3) — I2C3 error interrupt
94 DMA_MUX (DMAMUX) — DMAMUX overrun interrupt
95 QSPI — QSPI global interrupt
96 FFT_GLOBAL (FFT) — FFT global interrupt
97 DMA1_Channel5 (DMA1) — DMA1 Channel5 global interrupt
98 DMA1_Channel6 (DMA1) — DMA1 Channel6 global interrupt
99 CLA — CLA interrupt
100 TMU — TMU interrupt
101 FAC_GLOBAL (FAC) — FAC interrupt
102 HPDF_GLOBAL0 (HPDF) — HPDF global 0 interrupt
103 HPDF_GLOBAL1 (HPDF) — HPDF global 1 interrupt
104 HPDF_GLOBAL2 (HPDF) — HPDF global 2 interrupt
105 HPDF_GLOBAL3 (HPDF) — HPDF global 3 interrupt
106 TIMER14 — TIMER14 global interrupt
107 TIMER15 — TIMER15 global interrupt
108 TIMER16 — TIMER16 global interrupt
109 CAN0_WK (CAN0) — CAN0 wakeup through EXTI Line 25 interrupt
110 CAN0_BUFF (CAN0) — CAN0 interrupt for message buffer
111 CAN0_BUSOFF (CAN0) — CAN0 interrupt for Bus off / Bus off done
112 CAN0_ERROR (CAN0) — CAN0 interrupt for Error
113 CAN0_ERROR_FTX (CAN0) — CAN0 interrupt for Error in fast transmission
114 CAN0_WARNING_TX (CAN0) — CAN0 interrupt for Transmit warning
115 CAN0_WARNING_RX (CAN0) — CAN0 interrupt for Receive warning
116 CAN1_WK (CAN1) — CAN1 wakeup through EXTI Line 26 interrupt
117 CAN1_BUFF (CAN1) — CAN1 interrupt for message buffer
118 CAN1_BUSOFF (CAN1) — CAN1 interrupt for Bus off / Bus off done
119 CAN1_ERROR (CAN1) — CAN1 interrupt for Error
120 CAN1_ERROR_FTX (CAN1) — CAN1 interrupt for Error in fast transmission
121 CAN1_WARNING_TX (CAN1) — CAN1 interrupt for Transmit warning
122 CAN1_WARNING_RX (CAN1) — CAN1 interrupt for Receive warning
123 CAN2_WK (CAN2) — CAN2 wakeup through EXTI Line 27 interrupt
124 CAN2_BUFF (CAN2) — CAN2 interrupt for message buffer
125 CAN2_BUSOFF (CAN2) — CAN2 interrupt for Bus off / Bus off done
126 CAN2_ERROR (CAN2) — CAN2 interrupt for Error
127 CAN2_ERROR_FTX (CAN2) — CAN2 interrupt for Error in fast transmission
128 CAN2_WARNING_TX (CAN2) — CAN2 interrupt for Transmit warning
129 CAN2_WARNING_RX (CAN2) — CAN2 interrupt for Receive warning
130 TIMER0_DEC (TIMER0) — TIMER0 decode interrupt
131 TIMER1_DEC (TIMER1) — TIMER1 decode interrupt
132 TIMER2_DEC (TIMER2) — TIMER2 decode interrupt
133 TIMER3_DEC (TIMER3) — TIMER3 decode interrupt
134 TIMER4_DEC (TIMER4) — TIMER4 decode interrupt
135 TIMER7_DEC (TIMER7) — TIMER7 decode interrupt
136 TIMER19_DEC (TIMER19) — TIMER19 decode interrupt
